/*
 * CAUTION: This file is automatically generated by Xilinx.
 * Version:  
 * Today is: Tue Mar 18 09:25:12 2025
 */


/dts-v1/;
#include "zynq-7000.dtsi"
#include "zynq-phosphor-7010-pl.dtsi"
#include "zynq-phosphor-7010-pcw.dtsi"
/ {
	chosen {
		bootargs = "earlycon";
		stdout-path = "serial0:115200n8";
	};
	aliases {
		ethernet0 = &gem0;
		i2c0 = &i2c2;
		i2c1 = &i2c0;
		i2c2 = &i2c1;
		serial0 = &uart0;
		spi0 = &qspi;
	};
	memory {
		device_type = "memory";
		reg = <0x0 0x20000000>;
	};
};
#include "zynq-phosphor-7010-user.dtsi"
